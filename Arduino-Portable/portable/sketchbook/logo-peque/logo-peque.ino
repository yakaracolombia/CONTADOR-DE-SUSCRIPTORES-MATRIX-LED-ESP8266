/*******************************************************************
    Using a 64 * 32 RGB Matrix to display YT Subscriber stats
 *                                                                 *
    Written by Brian Lough
    https://www.youtube.com/channel/UCezJOfu7OtqGzd5xrP3q6WA


    Adaptacion a pantalla 64*64 e implementacion de Youtube Api v3 @mundoyakara
 *******************************************************************/

// ----------------------------
// Standard Libraries - Already Installed if you have ESP8266 set up
// ----------------------------

#include <Ticker.h>
#include <ESP8266WiFi.h>
#include <WiFiClientSecure.h>


// ----------------------------
// Additional Libraries - each one of these will need to be installed.
// ----------------------------


#include <PxMatrix.h>
// The library for controlling the LED Matrix
// Needs to be manually downloaded and installed
// https://github.com/2dom/PxMatrix

#include <YoutubeApi.h>
// For fetching the stats from the YouTube API
// Search for "YouTube" in the Arduino Library manager
// https://github.com/witnessmenow/arduino-youtube-api

#include <ArduinoJson.h>
// This Sketch doesn't technically need this, but the YT library does so it must be installed.
// Search for "ArduinoJson" in the library manger
// https://github.com/bblanchon/ArduinoJson


//------- Replace the following! ------
char ssid[] = "EL-NOMBRE-DE-TU-RED";       // your network SSID (name)
char password[] = "LA-CONTRASENA-DE-TU-RED";  // your network key
#define API_KEY "TU-API-KEY-DE-YOUTUBE"  // your google apps API Token (see readme of YT API library)
#define CHANNEL_ID "UCewluu5y7lA4QnXBJa_AbwQ" // LA ID TU CANAL 
//------------------------------

Ticker display_ticker;

WiFiClientSecure client;
YoutubeApi api(API_KEY, client);

unsigned long api_mtbs = 60000; //mean time between api requests
unsigned long api_lasttime = 60000;   //last time api request has been done
unsigned long timeBetweenRequests = 60000;
unsigned long nextRunTime;

long subs = 0;

// Pins for LED MATRIX
#define P_LAT 16
#define P_A 5
#define P_B 4
#define P_C 15
#define P_OE 2
#define P_D 12
#define P_E 0

// PxMATRIX display(32,16,P_LAT, P_OE,P_A,P_B,P_C);
// PxMATRIX display(64,32,P_LAT, P_OE,P_A,P_B,P_C,P_D);
PxMATRIX display(64, 64, P_LAT, P_OE, P_A, P_B, P_C, P_D, P_E);

// Some standard colors
uint16_t myRED = display.color565(255, 0, 0);
uint16_t myGREEN = display.color565(0, 255, 0);
uint16_t myBLUE = display.color565(0, 0, 255);
uint16_t myWHITE = display.color565(255, 255, 255);
uint16_t myYELLOW = display.color565(255, 255, 0);
uint16_t myCYAN = display.color565(0, 255, 255);
uint16_t myMAGENTA = display.color565(255, 0, 255);
uint16_t myBLACK = display.color565(0, 0, 0);

uint16 myCOLORS[8] = {myRED, myGREEN, myBLUE, myWHITE, myYELLOW, myCYAN, myMAGENTA, myBLACK};

// Converted using the following site: http://www.rinkydinkelectronics.com/t_imageconverter565.php
uint16_t static youTubeBigger[] = {
0x0000, 0x0000, 0x0000, 0x0000, 0x0000, 0xE800, 0xF000, 0xF800, 0xF800, 0xF800, 0xF800, 0xF800, 0xF800, 0xF800, 0xF800, 0xF800,   // 0x0010 (16) pixels
0xF800, 0xF800, 0xF800, 0xF800, 0xF800, 0xF800, 0xF800, 0xF800, 0xF800, 0xF800, 0xF800, 0xF800, 0xF800, 0xF800, 0xF800, 0xF800,   // 0x0020 (32) pixels
0xF800, 0xF800, 0xF800, 0xF800, 0xF800, 0xF000, 0xE800, 0x0000, 0x0000, 0x0000, 0x0000, 0x0000, 0x0000, 0x0000, 0x0000, 0xF800,   // 0x0030 (48) pixels
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0xF800, 0xF800, 0xF800, 0xF800, 0xF800, 0xF800, 0xF800, 0xF800, 0xF800, 0xF800, 0xF800, 0xF800, 0xF000, 0xD800, 0xE000, 0x0000,   // 0x0550 (1360) pixels
};

// ISR for display refresh
void display_updater()
{

  display.display(0);

}
void setup() {

 // Define your display layout here, e.g. 1/8 step
  display.begin(32);
  //display.setScanPattern(ZAGGIZ);
  //display.setMuxPattern(STRAIGHT);
  display.clearDisplay();
  display.setTextColor(myCYAN);
  display.setCursor(2, 20);
  display.print("Conectando");
  display.setTextColor(myCYAN);
  display.setCursor(2, 28);
  display.print("A la red");
  display.setTextColor(myGREEN);
  display.setCursor(2, 36);
  display.print("WiFi!");
  


  // Set WiFi to station mode and disconnect from an AP if it was Previously
  // connected
  WiFi.mode(WIFI_STA);
  WiFi.disconnect();
  delay(100);

  // Attempt to connect to Wifi network:
  Serial.print("Connecting Wifi: ");
  Serial.println(ssid);
  WiFi.begin(ssid, password);
  while (WiFi.status() != WL_CONNECTED) {
    Serial.print(".");
    delay(500);
  }
  Serial.println("");
  Serial.println("WiFi connected");
  Serial.println("IP address: ");
  IPAddress ip = WiFi.localIP();
  Serial.println(ip);
  client.setInsecure();


  Serial.begin(9600);

  Serial.print("Pixel draw latency in us: ");
  unsigned long start_timer = micros();
  display.drawPixel(1, 1, 0);
  unsigned long delta_timer = micros() - start_timer;
  Serial.println(delta_timer);

  Serial.print("Display update latency in us: ");
  start_timer = micros();
  display.display(0);
  delta_timer = micros() - start_timer;
  Serial.println(delta_timer);

  display_ticker.attach(0.002, display_updater);
  yield();
  delay(1000);
  display.clearDisplay();
  displayName("ESP8266","YT COUNTER"); // seemed to crash when I used lower case letters at the bottom!
  delay(5000);
}

void drawYouTube(int x, int y)
{
  int counter = 0;
  for (int yy = 0; yy < 30; yy++)
  {
    for (int xx = 0; xx < 44; xx++)
    {
      display.drawPixel(xx + x , yy + y, youTubeBigger[counter]);
      counter++;
    }
  }
}

void displayText(String text, int yPos) {
  int16_t  x1, y1;
  uint16_t w, h;
  display.setTextSize(1);
  char charBuf[text.length() + 1];
  text.toCharArray(charBuf, text.length() + 1);
  display.getTextBounds(charBuf, 0, yPos, &x1, &y1, &w, &h);
  int startingX = 33 - (w / 2);
  if (startingX < 0) {
    display.setTextSize(1);
    display.getTextBounds(charBuf, 0, yPos, &x1, &y1, &w, &h);
    startingX = 33 - (w / 2);
  }
  display.setCursor(startingX, yPos);
  Serial.println(startingX);
  Serial.println(yPos);
  display.print(text);
}

void updateScreen(long subCount) {
  display.clearDisplay();
  drawYouTube(10, 9);
  display.setTextColor(myWHITE);
  displayText(String(subCount), 47);
}

void displayName(String first, String last)
{
  display.setTextColor(myGREEN);
  displayText(first,21);
  display.setTextColor(myMAGENTA);
  displayText(last, 37);
}

void loop() {
  if (millis() - api_lasttime > api_mtbs)  {
    if (api.getChannelStatistics(CHANNEL_ID))
    {
      Serial.println("---------Stats---------");
      Serial.print("Subscriber Count: ");
      Serial.println(api.channelStats.subscriberCount);
      updateScreen(api.channelStats.subscriberCount);
    }
    api_lasttime = millis();
  }
}
